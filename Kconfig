## Kconfig
```kconfig
#
# Copyright (c) 2026 Nordic Semiconductor ASA
#
# SPDX-License-Identifier: LicenseRef-Nordic-5-Clause
#

menuconfig ATT_MODULES
	bool "ATT modules"
	help
	  Build the Asset Tracker Template modules into this image.
	  Zephyr processes the module for every sysbuild image, so only the
	  application image enables this option.

if ATT_MODULES

rsource "modules/power/Kconfig.power"
rsource "modules/uart_power_control/Kconfig.uart_power_control"
rsource "modules/network/Kconfig.network"
rsource "modules/cloud/Kconfig.cloud"
rsource "modules/location/Kconfig.location"
rsource "modules/led/Kconfig.led"
rsource "modules/fota/Kconfig.fota"
rsource "modules/environmental/Kconfig.environmental"
rsource "modules/button/Kconfig.button"
rsource "modules/storage/Kconfig.storage"

# Log level for common/ and cbor/, also used by the application's main module.
module = APP
module-str = APP
source "subsys/logging/Kconfig.template.log_config"

endif # ATT_MODULES
```

## app/src/modules/mwc_data/Kconfig.mwc_data
```kconfig
menuconfig APP_MWC_DATA
	bool "MWC Data module"
	default y
	select ZBUS
	select SMF

if APP_MWC_DATA

module = APP_MWC_DATA
module-str = MWC Data
source "subsys/logging/Kconfig.template.log_config"

config APP_MWC_DATA_CSV
	bool "Format MWC data output as CSV"
	default n
	help
		When enabled, the MWC Data module sends data as a comma-separated string.
		The output contains 13 columns:
		IMEI, ping, rsrp, band, ue_mode, operator, latitude, longitude, accuracy, battery, temp, pressure, humidity.
		If battery or environmental data is not available, the corresponding
		fields will be left empty.

config APP_MWC_DATA_LATITUDE
	string "Default latitude"
	default "0.0"
	help
		Default latitude value to include in the data output.

config APP_MWC_DATA_LONGITUDE
	string "Default longitude"
	default "0.0"
	help
		Default longitude value to include in the data output.

config APP_MWC_DATA_GPS_ACCURACY
	int "GPS accuracy in meters"
	default 0
	help
		GPS accuracy in meters to include in the data output.
		A value of 0 indicates unknown accuracy.

config APP_NTN_AT_CFUN
	string "AT command for setting modem functionality"
	default "AT+CFUN=0"
	help
		AT command to set modem to minimum functionality

config APP_NTN_AT_CGDCONT
	string "AT command for setting APN"
	default "AT+CGDCONT=0,\"IP\",\"internet.m2mportal.de\""
	help
		AT command to set APN for data connection

config APP_NTN_AT_SYSTEMMODE
	string "AT command for setting system mode"
	default "AT%XSYSTEMMODE=0,1,0,0"
	help
		AT command to set system mode to NB-IoT only

config APP_NTN_AT_EPCO
	string "AT command for eDRX settings"
	default "AT%XEPCO=0"
	help
		AT command to disable eDRX

config APP_NTN_AT_SETGPSPOS
	string "AT command for setting GPS position"
	default "AT%XSETGPSPOS=186260,151512,215000"
	help
		AT command to set GPS position

config APP_NTN_AT_NTNFEAT
	string "AT command for NTN features"
	default "AT%XNTNFEAT=0,0"
	help
		AT command to configure NTN features

config APP_NTN_AT_BANDLOCK
	string "AT command for band lock"
	default "AT%XBANDLOCK=2,\"10000000000000000000000000000000000000000000000000000000000000000\""
	help
		AT command to set band lock

endif # APP_MWC_DATA 
```

## app/src/modules/soil_sensor/Kconfig.soil_sensor
```kconfig
#
# Copyright (c) 2026 Nordic Semiconductor ASA
#
# SPDX-License-Identifier: LicenseRef-Nordic-5-Clause
#

menuconfig APP_SOIL_SENSOR
	bool "Soil sensor module"
	default y
	help
	  Mock soil sensor that reports moisture and temperature as a bounded random walk.

if APP_SOIL_SENSOR

config APP_SOIL_SENSOR_THREAD_STACK_SIZE
	int "Thread stack size"
	default 1024

config APP_SOIL_SENSOR_WATCHDOG_TIMEOUT_SECONDS
	int "Watchdog timeout"
	default 120
	help
	  Timeout in seconds for the soil sensor module watchdog.
	  The timeout given in this option covers both:
	    * Waiting for an incoming message in zbus_sub_wait_msg().
	    * Time spent processing the message, defined by
	      CONFIG_APP_SOIL_SENSOR_MSG_PROCESSING_TIMEOUT_SECONDS.
	  Ensure that this value exceeds CONFIG_APP_SOIL_SENSOR_MSG_PROCESSING_TIMEOUT_SECONDS.

config APP_SOIL_SENSOR_MSG_PROCESSING_TIMEOUT_SECONDS
	int "Maximum message processing time"
	default 3
	help
	  Maximum time allowed for processing a single message in the module's state machine.
	  The value must be smaller than CONFIG_APP_SOIL_SENSOR_WATCHDOG_TIMEOUT_SECONDS.

module = APP_SOIL_SENSOR
module-str = SOIL_SENSOR
source "subsys/logging/Kconfig.template.log_config"

endif # APP_SOIL_SENSOR
```

## west.yml
```yaml
# Copyright (c) 2026 Nordic Semiconductor ASA
# SPDX-License-Identifier: LicenseRef-Nordic-5-Clause

manifest:
  self:
    path: att-tracker

  remotes:
    - name: ncs
      url-base: https://github.com/nrfconnect
    - name: jhn
      url-base: https://github.com/jhn-nordic

  projects:
    - name: nrf
      remote: ncs
      repo-path: sdk-nrf
      revision: v3.5.0-preview3
      import: true
    - name: att-modules
      remote: jhn
      repo-path: Asset-Tracker-Template
      revision: cursor/att-modules-2691
      path: modules/lib/att-modules
```
